## drivers/counter/Kconfig.rpi_pico
```kconfig
# Copyright (c) 2022 Jimmy Ou
# SPDX-License-Identifier: Apache-2.0

# This config is depends on WDT_RPI_PICO because the timer uses the referencethat
# that is generated in the Watchdog.
config COUNTER_RPI_PICO_TIMER
	default y
	depends on WDT_RPI_PICO
	depends on DT_HAS_RASPBERRYPI_PICO_COUNTER_ENABLED
	select PICOSDK_USE_CLAIM
	select PICOSDK_USE_TIMER
	bool "Raspberry Pi Pico Counter Driver based on Timer"
```

## dts/bindings/counter/raspberrypi,pico-counter.yaml
```yaml
# Copyright (c) 2022, Jimmy Ou
# SPDX-License-Identifier: Apache-2.0

description: Raspberry Pi Pico Counter

compatible: "raspberrypi,pico-counter"

include: base.yaml

properties:
    reg:
      required: true

    interrupts:
      required: true
```

## samples/drivers/counter/alarm/Kconfig
```kconfig
# Config for counter alarm sample

# Copyright (c) 2019 Nordic Semiconductor ASA
# SPDX-License-Identifier: Apache-2.0

config COUNTER_SAM0_TC32
	bool
	default y if BOARD_ATSAMD20_XPRO

config WATCHDOG
	bool
	default y if SOC_RP2040

source "Kconfig.zephyr"
```
